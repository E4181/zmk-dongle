## boards/shields/dongle/Kconfig.defconfig
```kconfig
if SHIELD_DONGLE_CENTRAL_DONGLE

# Max 16 characters in keyboard name
config ZMK_KEYBOARD_NAME
    default "dongle_central_dongle"

config ZMK_SPLIT_ROLE_CENTRAL
    default y

endif
    
if SHIELD_DONGLE_CENTRAL_DONGLE || SHIELD_DONGLE_PERIPHERAL_LEFT || SHIELD_DONGLE_PERIPHERAL_RIGHT

config ZMK_SPLIT
    default y

endif

if SHIELD_DONGLE_PERIPHERAL_LEFT
config SPI
    default y
endif

# Set this to ZMK_SPLIT_BLE_CENTRAL_PERIPHERALS + your desired number of BT profiles (default is 5)
config BT_MAX_CONN
    default 6
# Set this to the same number as BT_MAX_CONN
config BT_MAX_PAIRED
    default 6

if ZMK_DISPLAY

config I2C
    default y

config SSD1306
    default y

choice ZMK_DISPLAY_WORK_QUEUE
    default ZMK_DISPLAY_WORK_QUEUE_DEDICATED
endchoice

endif

if SSD1306

config LV_Z_VDB_SIZE
    default 64

config LV_DPI_DEF
    default 148

config LV_Z_BITS_PER_PIXEL
    default 1

choice LV_COLOR_DEPTH
    default LV_COLOR_DEPTH_1
endchoice

endif

if LVGL

config LV_Z_VDB_SIZE
    default 64

config LV_DPI_DEF
    default 148

config LV_Z_BITS_PER_PIXEL
    default 1

choice LV_COLOR_DEPTH
    default LV_COLOR_DEPTH_1
endchoice

endif
```

## boards/shields/dongle/Kconfig.shield
```kconfig
config SHIELD_DONGLE_CENTRAL_DONGLE
    def_bool $(shields_list_contains,dongle_central_dongle)
    
config SHIELD_DONGLE_PERIPHERAL_LEFT
    def_bool $(shields_list_contains,dongle_peripheral_left)

config SHIELD_DONGLE_PERIPHERAL_RIGHT
    def_bool $(shields_list_contains,dongle_peripheral_right)
```
