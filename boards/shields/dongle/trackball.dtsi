#include <dt-bindings/zmk/input_transform.h>

/ {
    split_inputs {
        #address-cells = <1>;
        #size-cells = <0>;

        trackball: trackball@0 {
            compatible = "pixart,pmw3610";
            reg = <0>;
            spi-max-frequency = <2000000>;
            irq-gpios = <&gpio0 6 (GPIO_ACTIVE_LOW | GPIO_PULL_UP)>;  //for MOTION pin
            cpi = <1000>;
            evt-type = <INPUT_EV_REL>;
            #x-input-code = <INPUT_REL_X>;
            #y-input-code = <INPUT_REL_Y>;
            force-awake;
            force-awake-4ms-mode;
        };
    };

    trackball_listener {
        compatible = "zmk,input-listener";
        device = <&trackball>;
    };
};